#include <zephyr/dt-bindings/input/input-event-codes.h>
#include "ezeco_lemon.dtsi"

&default_transform {
    col-offset = <7>;
};

/*
 * PAW3395 trackball sensor on the VIK connector, sharing SPI1 with the 595.
 * VIK CS = P0.08, motion = VIK AD_2 (P0.31), same as the Cosmos PMW3610 VIK module.
 * Confirm against the thebigskree adapter pinout.
 */
&spi1 {
    cs-gpios = <&gpio0 4 GPIO_ACTIVE_LOW>, <&gpio0 8 GPIO_ACTIVE_LOW>;

    trackball: trackball@1 {
        compatible = "pixart,paw3395";
        status = "okay";
        reg = <1>;
        spi-max-frequency = <4000000>;
        irq-gpios = <&gpio0 31 (GPIO_ACTIVE_LOW | GPIO_PULL_UP)>;
        cpi = <800>;
        evt-type = <INPUT_EV_REL>;
        x-input-code = <INPUT_REL_X>;
        y-input-code = <INPUT_REL_Y>;
    };
};

&trackball_split {
    status = "okay";
    device = <&trackball>;
};
