## boards/shields/ezeco/Kconfig.defconfig
```kconfig
if SHIELD_EZECO_DONGLE

config ZMK_KEYBOARD_NAME
    default "ezeco"

config ZMK_SPLIT_ROLE_CENTRAL
    default y

# Left half, right half, mouse.
config ZMK_SPLIT_BLE_CENTRAL_PERIPHERALS
    default 3

# BLE host profiles (5) + peripherals (3).
config BT_MAX_CONN
    default 8

config BT_MAX_PAIRED
    default 8

endif # SHIELD_EZECO_DONGLE

if SHIELD_EZECO_DONGLE || SHIELD_EZECO_LEFT || SHIELD_EZECO_RIGHT || SHIELD_EZECO_MOUSE

config ZMK_SPLIT
    default y

endif
```

## boards/shields/ezeco/Kconfig.shield
```kconfig
config SHIELD_EZECO_DONGLE
    def_bool $(shields_list_contains,ezeco_dongle)

config SHIELD_EZECO_LEFT
    def_bool $(shields_list_contains,ezeco_left)

config SHIELD_EZECO_RIGHT
    def_bool $(shields_list_contains,ezeco_right)

config SHIELD_EZECO_MOUSE
    def_bool $(shields_list_contains,ezeco_mouse)
```
